## board.yml
```yaml
board:
  name: ropixon_ZG_v5_0
  vendor: Ropixon
  socs:
  - name: nrf54l15
    variants:
    - name: xip
      cpucluster: cpuflpr
```

## boards/Ropixon/ropixon_ZG_v5_0/Kconfig.ropixon_ZG_v5_0
```kconfig
config BOARD_ROPIXON_ZG_V5_0
	select SOC_NRF54L15_CPUAPP if BOARD_ROPIXON_ZG_V5_0_NRF54L15_CPUAPP
	select SOC_NRF54L15_CPUFLPR if \
		BOARD_ROPIXON_ZG_V5_0_NRF54L15_CPUFLPR || \
		BOARD_ROPIXON_ZG_V5_0_NRF54L15_CPUFLPR_XIP
```
